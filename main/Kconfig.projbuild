## main/Kconfig.projbuild
```kconfig
menu "AxeForge"

    choice AF_BOARD
        prompt "Target board"
        default AF_BOARD_NERDQAXE
        help
            Each board gets its own firmware image: pinouts differ, and driving a
            pin that belongs to another board's regulator is never safe.
        config AF_BOARD_NERDQAXE
            bool "NerdQaxe++ (4x BM1370)"
        config AF_BOARD_NERDQAXEPLUS
            bool "NerdQAxe+ (4x BM1368)"
        config AF_BOARD_NERDOCTAXEPLUS
            bool "NerdOctaxe+ (8x BM1368)"
        config AF_BOARD_NERDOCTAXEGAMMA
            bool "NerdOctaxe-gamma (8x BM1370)"
        config AF_BOARD_NERDQX
            bool "NerdQX (4x BM1370, die sensors)"
        config AF_BOARD_NERDAXE
            bool "NerdAxe (1x BM1366, T-Display-S3)"
        config AF_BOARD_SUPRAHEX
            bool "Bitaxe Supra Hex 701/702 (6x BM1368)"
        config AF_BOARD_NEXUS
            bool "Nexus S1 (4x BM1373) - EXPERIMENTAL"
    endchoice


    menu "Big display (3.5in 480x320)"
        depends on !AF_BOARD_SUPRAHEX
        choice AF_LCD_BUS
            prompt "Interface"
            default AF_LCD_BUS_I80
            config AF_LCD_BUS_I80
                bool "8-bit parallel (i80)"
            config AF_LCD_BUS_SPI
                bool "SPI"
        endchoice

        choice AF_LCD_CONTROLLER
            prompt "LCD controller"
            default AF_LCD_ST7796
            config AF_LCD_ST7796
                bool "ST7796S"
            config AF_LCD_ILI9488
                bool "ILI9488"
        endchoice

        config AF_LCD_PIN_D0
            int "D0 GPIO"
            depends on AF_LCD_BUS_I80
            default 39
        config AF_LCD_PIN_D1
            int "D1 GPIO"
            depends on AF_LCD_BUS_I80
            default 40
        config AF_LCD_PIN_D2
            int "D2 GPIO"
            depends on AF_LCD_BUS_I80
            default 41
        config AF_LCD_PIN_D3
            int "D3 GPIO"
            depends on AF_LCD_BUS_I80
            default 42
        config AF_LCD_PIN_D4
            int "D4 GPIO"
            depends on AF_LCD_BUS_I80
            default 45
        config AF_LCD_PIN_D5
            int "D5 GPIO"
            depends on AF_LCD_BUS_I80
            default 46
        config AF_LCD_PIN_D6
            int "D6 GPIO"
            depends on AF_LCD_BUS_I80
            default 47
        config AF_LCD_PIN_D7
            int "D7 GPIO"
            depends on AF_LCD_BUS_I80
            default 48
        config AF_LCD_PIN_WR
            int "WR (write clock) GPIO"
            depends on AF_LCD_BUS_I80
            default 8
        config AF_LCD_PIN_RD
            int "RD GPIO (held high, -1 = none)"
            depends on AF_LCD_BUS_I80
            default 9
        config AF_LCD_I80_KHZ
            int "Parallel write clock (kHz)"
            depends on AF_LCD_BUS_I80
            range 2000 40000
            default 20000

        config AF_LCD_PIN_SCLK
            int "SCLK GPIO"
            depends on AF_LCD_BUS_SPI
            default 8
        config AF_LCD_PIN_MOSI
            int "MOSI (SDA) GPIO"
            depends on AF_LCD_BUS_SPI
            default 39
        config AF_LCD_SPI_MHZ
            int "SPI clock (MHz)"
            depends on AF_LCD_BUS_SPI
            range 10 80
            default 40

        config AF_LCD_PIN_CS
            int "CS GPIO"
            default 6
        config AF_LCD_PIN_DC
            int "DC (RS) GPIO"
            default 7
        config AF_LCD_PIN_RST
            int "RST GPIO (-1 = not connected)"
            default 5
        config AF_LCD_PIN_BL
            int "Backlight GPIO (-1 = always on)"
            default 38
        config AF_LCD_PIN_PWR
            int "Peripheral power enable GPIO, driven high (-1 = none)"
            default 15
        config AF_LCD_ROTATE_180
            bool "Rotate 180 degrees"
            default y if AF_BOARD_NERDQX
            default n
        config AF_LCD_INVERT_COLORS
            bool "Invert colors (IPS panels usually need this)"
            default y
        config AF_LCD_BGR
            bool "BGR color order"
            default y
    endmenu

    menu "Hard safety limits (auto-tuner can never exceed these)"
        config AF_MAX_FREQ_MHZ
            int "Max ASIC frequency (MHz)"
            range 400 1250
            default 625 if AF_BOARD_SUPRAHEX || AF_BOARD_NERDQAXEPLUS || AF_BOARD_NERDOCTAXEPLUS
            default 600 if AF_BOARD_NERDAXE
            default 1000 if AF_BOARD_NERDQX
            default 500 if AF_BOARD_NEXUS  # stock v1.0.2 stops at 450; 475 MHz / 975 mV ran clean
            default 750
        config AF_MAX_CORE_MV
            int "Max core voltage (mV)"
            range 1000 1350
            default 1350 if AF_BOARD_NERDQX
            default 1000 if AF_BOARD_NEXUS  # stock allows 1050, but that draws ~185 W, over the 170 W cap
            default 1300
        config AF_MIN_CORE_MV
            int "Min core voltage (mV)"
            range 900 1200
            default 900 if AF_BOARD_NEXUS
            default 1100
        config AF_MAX_CHIP_TEMP
            int "Tuner chip temperature ceiling (C)"
            default 68
        config AF_CRIT_CHIP_TEMP
            int "Emergency shutdown chip temperature (C)"
            default 80
        config AF_MAX_VR_TEMP
            int "Tuner VR temperature ceiling (C)"
            default 95 if AF_BOARD_SUPRAHEX
            default 85
        config AF_CRIT_VR_TEMP
            int "Emergency shutdown VR temperature (C)"
            default 105 if AF_BOARD_SUPRAHEX
            default 100
        config AF_MAX_POWER_W
            int "Max input power (W)"
            default 120 if AF_BOARD_SUPRAHEX
            default 15 if AF_BOARD_NERDAXE
            default 70 if AF_BOARD_NERDQAXEPLUS
            default 130 if AF_BOARD_NERDOCTAXEPLUS
            default 250 if AF_BOARD_NERDOCTAXEGAMMA
            default 240 if AF_BOARD_NERDQX
            default 170 if AF_BOARD_NEXUS  # stock draws ~148 W at 450 MHz; shufps' Q1373 allows 180
            default 100

        comment "Rev7 boards (TPS546 regulator, detected at boot)"
            depends on AF_BOARD_NERDQAXE
        config AF_REV7_MAX_FREQ_MHZ
            int "Rev7 max ASIC frequency (MHz)"
            depends on AF_BOARD_NERDQAXE
            range 400 1000
            default 1000
        config AF_REV7_MAX_POWER_W
            int "Rev7 max power (W)"
            depends on AF_BOARD_NERDQAXE
            default 120
        config AF_REV7_MAX_VR_TEMP
            int "Rev7 tuner regulator temperature ceiling (C)"
            depends on AF_BOARD_NERDQAXE
            default 95
        config AF_REV7_CRIT_VR_TEMP
            int "Rev7 emergency shutdown regulator temperature (C)"
            depends on AF_BOARD_NERDQAXE
            default 105
        comment "NerdOctaxe-gamma rev3.0+ (TPS53667 regulator, detected at boot)"
            depends on AF_BOARD_NERDOCTAXEGAMMA
        config AF_G67_MAX_FREQ_MHZ
            int "TPS53667 board max ASIC frequency (MHz)"
            depends on AF_BOARD_NERDOCTAXEGAMMA
            range 400 850
            default 800
        config AF_G67_MAX_POWER_W
            int "TPS53667 board max power (W)"
            depends on AF_BOARD_NERDOCTAXEGAMMA
            default 300
    endmenu

endmenu
```
